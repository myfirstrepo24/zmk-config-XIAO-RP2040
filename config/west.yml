## config/west.yml
```yaml
manifest:
  remotes:
    - name: zmkfirmware
      url: https://github.com/zmkfirmware
  projects:
    - name: zmk
      repo-path: zmk
      remote: zmkfirmware
      revision: main
```
